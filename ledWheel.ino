#include <avr/pgmspace.h>
#include <FastLED.h>

#define LED_PIN 9
#define NUM_LEDS 32
#define LED_TYPE APA102
#define COLOR_ORDER BGR

const PROGMEM uint8_t IMAGE[][3*NUM_LEDS]  = {
	{252,207,51,253,207,51,253,207,51,252,208,51,252,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196,51},
	{252,207,51,253,207,51,253,207,51,252,208,51,252,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195,49},
	{252,207,51,253,207,51,253,207,51,252,208,51,253,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195,47},
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	{252,207,51,253,207,51,253,207,51,252,208,51,252,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198,55}

};


const int DIVISIONS = sizeof(IMAGE)/sizeof(IMAGE[0]);
const uint8_t INTERRUPT_PIN = 2;
const int DIVISIONS_div2 = DIVISIONS/2; 
const uint8_t NUM_LEDS_div2 = NUM_LEDS/2;
volatile unsigned long crossing_millis = 0;
volatile unsigned long previous_crossing_millis = 0;

uint8_t last_position = 0;
uint8_t curr_position = 0;
int position = 0;
const uint8_t BRIGHTNESS = 30;
const uint8_t led_offset = 16;
CRGB leds[NUM_LEDS];

volatile unsigned long test_val = 0;


void OnCrossingUpdate()
{
	previous_crossing_millis = crossing_millis;
	crossing_millis = millis();
}


void setup()
{

  FastLED.addLeds<LED_TYPE, BGR>(leds, NUM_LEDS);
  FastLED.setBrightness(BRIGHTNESS);
  set_max_power_in_volts_and_milliamps(5, 500);               // FastLED Power management set at 5V, 500mA
  pinMode(INTERRUPT_PIN, INPUT_PULLUP);
  attachInterrupt(digitalPinToInterrupt(INTERRUPT_PIN), OnCrossingUpdate, RISING); 
  Serial.begin(9600);
  FastLED.clear();
}

void loop() 
{
	uint16_t i;
	uint8_t R;
	uint8_t G;
	uint8_t B;
	float ratio = (millis()-crossing_millis) / (float)(crossing_millis-previous_crossing_millis);
	
	if (ratio > 1)
	{
		ratio = ratio - (int)ratio;
	}

	curr_position = ratio * DIVISIONS;

	if (curr_position == last_position)
	{
		return;
	}


    // at current position LEDS(17...32] occupy pixels 0,2,4,6..
	const int curr_position_minus1 = curr_position-1;

	uint8_t j = 0; // LED 0's Red col
	for(i = NUM_LEDS_div2; i<NUM_LEDS; i++)
	{
		//uint8_t j = (i-led_offset)*2*3;
		R = pgm_read_byte(&(IMAGE[curr_position_minus1][j++]));
		G = pgm_read_byte(&(IMAGE[curr_position_minus1][j++]));
		B = pgm_read_byte(&(IMAGE[curr_position_minus1][j]));
		leds[i] = CRGB(R,G,B);
		j += 4; // skip 1 led
	}

	if (curr_position >= DIVISIONS_div2)
	{
		position = curr_position - DIVISIONS_div2;
	}
	else
	{
		position = curr_position + DIVISIONS_div2;
	}

 // leds 0 thru 15 occupy pixels 1,3,5,7...	at opposite position of current_position
	uint8_t k = 3;  // LED 1's Red Col
	for(i = NUM_LEDS_div2-1; i >=0 ; i--)
	{
		//uint8_t j = ((led_offset-i)*2-1)*3;
		R = pgm_read_byte(&(IMAGE[position][k++]));
		G = pgm_read_byte(&(IMAGE[position][k++]));
		B = pgm_read_byte(&(IMAGE[position][k]));
		leds[i] = CRGB(R,G,B);
		k+=4;
	}
//show_at_max_brightness_for_power();
	FastLED.show();
	last_position = curr_position;

}  




